## firmware/estacao/main/Kconfig.projbuild
```kconfig
menu "Estacao - teste de bancada"

    choice ESTACAO_TESTE
        prompt "Modo de operacao no boot"
        default ESTACAO_MODO_ESTACAO
        help
            Seleciona o codigo que o app_main executa: o firmware da
            estacao (pacote periodico), o modo bancada (leitura continua
            de tudo) ou o teste isolado de um sensor.

        config ESTACAO_MODO_ESTACAO
            bool "estacao (pacote periodico — producao)"

        config ESTACAO_TESTE_TODOS
            bool "todos (modo bancada)"

        config ESTACAO_TESTE_BMP280
            bool "BMP280 - temperatura/pressao (I2C, GPIOs 21/22)"

        config ESTACAO_TESTE_LDR
            bool "LDR - luminosidade (GPIO 34, ADC)"

        config ESTACAO_TESTE_CHUVA
            bool "MH-RD - chuva (GPIO 35 AO + GPIO 27 DO)"

        config ESTACAO_TESTE_DHT11
            bool "DHT11 - umidade/temperatura (GPIO 4)"

        config ESTACAO_TESTE_VENTO
            bool "Reed-switch - vento (GPIO 25, interrupcao)"

        config ESTACAO_TESTE_LED
            bool "LED RGB - status (GPIOs 16/17/13, LEDC)"

        config ESTACAO_TESTE_LORA
            bool "LoRa Ra-02 - bring-up SPI (le RegVersion, espera 0x12)"

        config ESTACAO_TESTE_LORA_TX
            bool "LoRa Ra-02 - TX de teste (433.0 MHz, SF12, +2 dBm)"

    endchoice

    config ESTACAO_INTERVALO_S
        int "Intervalo entre pacotes no modo estacao (segundos)"
        depends on ESTACAO_MODO_ESTACAO
        range 5 3600
        default 30
        help
            Periodo da tarefa principal: leitura de todos os sensores e
            montagem do pacote. Na Fase 4, baixar p/ testes de perda.

endmenu
```
